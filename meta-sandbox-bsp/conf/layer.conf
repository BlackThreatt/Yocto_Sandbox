## meta-sandbox-bsp/conf/machine/sandbox-stm32mp15.conf
```bitbake
# meta-sandbox-bsp/conf/machine/sandbox-stm32mp15.conf

require conf/machine/stm32mp15-disco.conf

MACHINEOVERRIDES =. "sandbox-stm32mp15:"

DEFAULTTUNE = "cortexa7thf-neon-vfpv4"

BOOTSCHEME_LABELS = "optee"

BOOTDEVICE_LABELS = "sdcard"
```

## meta-sandbox-bsp/conf/machine/sandbox-stm32mp25.conf
```bitbake
require conf/machine/stm32mp25-disco.conf

MACHINEOVERRIDES =. "sandbox-stm32mp25:"

DEFAULTTUNE = "cortexa35"

BOOTSCHEME_LABELS = "optee"
BOOTDEVICE_LABELS = "sdcard"

PREFERRED_PROVIDER_virtual/kernel = "linux-stm32mp"
PREFERRED_VERSION_linux-stm32mp = "6.6.78-stm32mp-r2"

EXTDT_USE_SUFFIX = '1'
KERNEL_DEVICETREE = "st/stm32mp257f-dk.dtb"
```
